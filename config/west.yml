## config/west.yml
```yaml
manifest:
  remotes:
    - name: zmkfirmware
      url-base: https://github.com/zmkfirmware
    - name: tokyo2006
      url-base: https://github.com/tokyo2006
    - name: englmaxi
      url-base: https://github.com/englmaxi
    - name: whoop-t
      url-base: https://github.com/whoop-t
  projects:
    - name: zmk
      remote: zmkfirmware
      revision: main
      import: app/west.yml
    - name: prospector-zmk-module
      remote: tokyo2006
      revision: micro_spi2
    - name: zmk-dongle-display
      remote: englmaxi
      revision: main
    - name: nice-one-punch-ok
      remote: whoop-t
      revision: main
  self:
    path: config
```
